// SPDX-License-Identifier: BSD-3-Clause

/dts-v1/;

#include <skeleton64.dtsi>
#include <lk2nd.dtsi>

/ {
	qcom,msm-id = <QCOM_ID_MSM8917 0>;
	// should i also add <QCOM_BOARD_ID_QRD, 0> as a second option?
	//qcom,board-id = <0x1000b 0x00>;
	qcom,board-id = <QCOM_BOARD_ID(QRD, 1, 0) 0>;
};

&lk2nd {
    model = "Lenovo Tab 4 10 (TB-X304X)";
    compatible = "lenovo,tbx304x";

    lk2nd,match-panel;
    panel {
        compatible = "lenovo,tbx304x-panel", "lk2nd,panel";

        qcom,mdss_dsi_nt35521s_wxga_video {
            compatible = "lenovo,tbx304x-nt35521s";
            touchscreen-compatible = "novatek,nt35521s";
        };
    };
};
