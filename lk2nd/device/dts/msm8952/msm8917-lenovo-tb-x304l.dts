// SPDX-License-Identifier: BSD-3-Clause

/dts-v1/;

#include <skeleton64.dtsi>
#include <lk2nd.dtsi>

/ {
	qcom,msm-id = <QCOM_ID_MSM8917 0>;
	qcom,board-id = <QCOM_BOARD_ID(QRD, 1, 0) 0>;
};

&lk2nd {
    model = "Lenovo Tab 4 10 (TB-X304L)";
    compatible = "lenovo,tb-x304l";

    lk2nd,match-panel;
    panel {
        compatible = "lenovo,tb-x304l-panel", "lk2nd,panel";

        qcom,mdss_dsi_nt35521s_wxga_video {
            compatible = "lenovo,tb-x304l-nt35521s";
            touchscreen-compatible = "novatek,nt35521s";
        };
    };
};
